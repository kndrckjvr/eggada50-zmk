## boards/shields/eggada50/Kconfig.defconfig
```kconfig
# Name must be less than 16 characters long!
if SHIELD_EGGADA50_LEFT

config ZMK_KEYBOARD_NAME
    default "Eggada50"

config ZMK_SPLIT_ROLE_CENTRAL
    default y

endif

if SHIELD_SOFLE_ERGOMECH_DONGLE

config ZMK_SPLIT
    default y

config ZMK_SPLIT_ROLE_CENTRAL
    default y

config ZMK_SPLIT_BLE_CENTRAL_PERIPHERALS
    default 3

endif

if SHIELD_EGGADA50_LEFT || SHIELD_EGGADA50_RIGHT

config ZMK_SPLIT
    default y

endif
```

## boards/shields/eggada50/Kconfig.shield
```kconfig
# No whitespace after the comma or in your part name!
config SHIELD_EGGADA50_LEFT
    def_bool $(shields_list_contains,eggad50_left)

# No whitespace after the comma or in your part name!
config SHIELD_EGGADA50_RIGHT
    def_bool $(shields_list_contains,eggad50_right)

config SHIELD_EGGADA50_DONGLE
    def_bool $(shields_list_contains,eggada50_dongle)
```

## config/west.yml
```yaml
manifest:
  defaults:
    revision: v0.2
  remotes:
    - name: zmkfirmware
      url-base: https://github.com/zmkfirmware
    # Additional modules containing boards/shields/custom code can be listed here as well
    # See https://docs.zephyrproject.org/3.2.0/develop/west/manifest.html#projects
    # - name: carrefinho                            # <--- add this
    #   url-base: https://github.com/carrefinho     # <--- and this
  projects:
    - name: zmk
      remote: zmkfirmware
      import: app/west.yml
    # - name: prospector-zmk-module                 # <--- and these
    #   remote: carrefinho                           # <---
    #   revision: main                              # <---
  self:
    path: config
```
